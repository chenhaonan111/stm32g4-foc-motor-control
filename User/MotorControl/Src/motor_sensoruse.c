#include "motor_sensoruse.h"
#include "math_drv.h"
#include "motor_publicdata.h"
#include "global_control.h"
#include "speed_drv.h"

void Current_Open_Loop(void);
void Current_Close_Loop(void);
void Speed_Current_Loop(void);
void Pos_Speed_Current_Loop(void);

void Sensoruse_Control(void)
{
    /* 步骤1：根据当前转子电角度（标幺值，范围0~1）计算其正弦和余弦值。
     *       这些值用于Park变换（将静止坐标系电流变换到旋转坐标系）
     *       以及反Park变换（将旋转坐标系电压变换到静止坐标系）。
     *       电角度来源于编码器，经电气角度换算得到。
     */    
    Calculate_Sin_Cos(MC.EAngle.ElectricalAnglePU,&MC.Foc.SinVal,&MC.Foc.CosVal);

  /* 步骤2：根据用户设定的运行模式，调用对应的控制环路 */
    switch(MC.Motor.RunMode)
    {       
        /* ---------- 模式1：电流开环控制 ---------- */
        case CURRENT_OPEN_LOOP:                                            
        {  
            /* 直接给定Uq电压（交轴电压分量），Ud通常为0。
             * 此模式下电机强制旋转，不进行电流闭环调节，
             * 常用于电机启动前的对齐、开环强拖或调试阶段。
             */            
            Current_Open_Loop();
        }break;    
        
    /* ---------- 模式2：电流闭环控制（力矩模式） ---------- */        
        case CURRENT_CLOSE_LOOP:                                           
        {            
            /* 给定交轴电流指令 Iq_ref，通过PI调节器得到Uq，
             * 同时可控制Id_ref（通常为0或弱磁电流）。
             * 此模式实现精确的力矩控制，适用于对力矩响应要求高的场景。
             */            
            Current_Close_Loop();
        }break;    

    /* ---------- 模式3：速度闭环 + 电流闭环 ---------- */        
        case SPEED_CURRENT_LOOP:
        {  
            /* 外环为速度环：给定目标转速，根据实际转速误差经PI生成Iq_ref；
             * 内环为电流环：根据Iq_ref经PI生成Uq。
             * 此模式实现恒转速控制，是最常见的FOC应用模式。
             */      
            Speed_Current_Loop();
        }break;    

    /* ---------- 模式4：位置闭环 + 速度闭环 + 电流闭环 ---------- */        
        case POS_SPEED_CURRENT_LOOP:
        {
            /* 最外环为位置环：给定目标位置，根据位置误差经PI生成速度指令；
             * 中环为速度环：根据速度指令与实际速度误差生成Iq_ref；
             * 内环为电流环：根据Iq_ref生成Uq。
             * 此模式实现精确定位控制，常用于伺服驱动器。
             */
            Pos_Speed_Current_Loop();
        }break;    
    }                     
}

/*电流开环控制（有感模式，强制旋转）*/
void Current_Open_Loop(void)
{
    /* 电流开环=转矩控制:Ud=0、Uq 给固定电压。
       Uq 决定电流 Iq≈Uq/Rs(Rs≈0.2Ω),从 0.5V 起步;
       转不动就调大,发烫/过流就调小。 */
    MC.Foc.Ud = 0.0f;
    MC.Foc.Uq = 0.5f;
    IPark_Transform(&MC.Foc);            // 反Park变换：Ud/Uq -> Ualpha/Ubeta
    MC.Foc.Ubus = MC.Sample.BusReal;     // 更新实时母线电压
    Calculate_SVPWM(&MC.Foc);            // SVPWM调制，生成三相占空比
}

/*电流闭环控制（有感模式*/
void Current_Close_Loop(void)
{
    // ------------------------------------------------------------------------
    // 1. 读取相电流实际值（反馈值）
    // ------------------------------------------------------------------------
    // 从采样结构体中获取真实的U相和V相电流（单位：安培）
    // 通常通过电流传感器和ADC采样得到。W相电流可由基尔霍夫电流定律计算：Iw = -Iu - Iv。
    MC.Foc.Iu = MC.Sample.IuReal;
    MC.Foc.Iv = MC.Sample.IvReal;

    // ------------------------------------------------------------------------
    // 2. Clark变换：将三相静止坐标系（Iu, Iv, Iw）变换到两相静止坐标系（Ialpha, Ibeta）
    // ------------------------------------------------------------------------
    // Clark变换公式：
    //   Ialpha = Iu
    //   Ibeta  = (Iu + 2*Iv) / sqrt(3)   （等幅值变换常用系数）
    // 输入：MC.Foc.Iu, MC.Foc.Iv  输出：MC.Foc.Ialpha, MC.Foc.Ibeta
    Clark_Transform(&MC.Foc);

    // ------------------------------------------------------------------------
    // 3. Park变换：将两相静止坐标系（Ialpha, Ibeta）变换到旋转坐标系（Id, Iq）
    // ------------------------------------------------------------------------
    // Park变换需要当前转子电角度（theta），将交流量变为直流量，便于PI调节。
    // 输入：Ialpha, Ibeta, theta  输出：Id（励磁电流分量）, Iq（转矩电流分量）
    // 公式：
    //   Id =  Ialpha*cos(theta) + Ibeta*sin(theta)
    //   Iq = -Ialpha*sin(theta) + Ibeta*cos(theta)
    Park_Transform(&MC.Foc);

//    // ------------------------------------------------------------------------
//    // 4. 对Id和Iq进行低通滤波（一阶低通滤波，减小噪声干扰）
//    // ------------------------------------------------------------------------
//    // 一阶低通滤波公式：Y(n) = X(n)*α + Y(n-1)*(1-α)
//    // 其中α为滤波系数（0~1之间），越接近1响应越快但滤波效果越差。
//    // IdLPFFactor 和 IqLPFFactor 是预设的滤波系数。
//    // 滤波后的值存储在 IdLPF / IqLPF 中，用于后续PID反馈。
//    MC.Foc.IdLPF = MC.Foc.Id * MC.Foc.IdLPFFactor + MC.Foc.IdLPF * (1 - MC.Foc.IdLPFFactor);
//    MC.Foc.IqLPF = MC.Foc.Iq * MC.Foc.IqLPFFactor + MC.Foc.IqLPF * (1 - MC.Foc.IqLPFFactor);

    // ------------------------------------------------------------------------
    // 5. 设置PID控制器的反馈值（使用滤波后的Id/Iq）
    // ------------------------------------------------------------------------
    MC.IqPid.Fbk = MC.Foc.Iq;   // Iq环反馈
    MC.IdPid.Fbk = MC.Foc.Id;   // Id环反馈

    // ------------------------------------------------------------------------
    // 6. 执行PID控制（比例-积分调节），输出Ud、Uq（旋转坐标系下的电压指令）
    // ------------------------------------------------------------------------
    // PID_Control函数内部根据参考值(Ref)和反馈值(Fbk)计算比例和积分项，
    // 并输出控制量(Out)，通常经过限幅处理。
    // 对于永磁同步电机，通常Iq环控制转矩，Id环控制励磁（一般令Id=0实现最大转矩电流比）。
    
    PID_Control(&MC.IqPid);        // 输出 MC.IqPid.Out 即为 Uq（q轴电压）
    PID_Control(&MC.IdPid);        // 输出 MC.IdPid.Out 即为 Ud（d轴电压）

    // ------------------------------------------------------------------------
    // 7. 更新电压指令到FOC结构体
    // ------------------------------------------------------------------------
    MC.Foc.Uq = MC.IqPid.Out;
    MC.Foc.Ud = MC.IdPid.Out;

    // ------------------------------------------------------------------------
    // 8. 反Park变换：将旋转坐标系电压（Ud, Uq）变换到两相静止坐标系（Ualpha, Ubeta）
    // ------------------------------------------------------------------------
    // 反Park变换公式（使用同样的电角度theta）：
    //   Ualpha = Ud*cos(theta) - Uq*sin(theta)
    //   Ubeta  = Ud*sin(theta) + Uq*cos(theta)
    // 输出：Ualpha, Ubeta
    IPark_Transform(&MC.Foc);

    // ------------------------------------------------------------------------
    // 9. 更新母线电压（直流母线电压采样值）
    // ------------------------------------------------------------------------
    // 母线电压用于SVPWM的占空比计算，实现电压补偿和过调制处理。
    MC.Foc.Ubus = MC.Sample.BusReal;

    // ------------------------------------------------------------------------
    // 10. SVPWM调制：根据Ualpha, Ubeta及母线电压，计算逆变器各相占空比并输出PWM
    // ------------------------------------------------------------------------
    // 空间矢量脉宽调制（Space Vector PWM），生成三相PWM波形驱动MOSFET/IGBT。
    // 输入：Ualpha, Ubeta, Ubus, theta（可能用于扇区判断等）  输出：三路PWM比较值
    Calculate_SVPWM(&MC.Foc);
}

/*速度-电流双闭环控制（有感FOC模式*/
void Speed_Current_Loop(void)
{
    // ------------------------------------------------------------------------
    // 1. 速度环执行计数器累加（用于分频执行速度环）
    // ------------------------------------------------------------------------
    // SpeedCalculateCnt 每次进入本函数都自增，当达到 SPEED_DIVISION_FACTOR 时才执行一次速度闭环，
    // 目的是降低速度环的计算频率（因为速度变化较慢，而电流环需要更高的响应速度）。
    // 这样可以在保证控制性能的同时，减轻MCU的运算负担。
    MC.Speed.SpeedCalculateCnt++;

    // ------------------------------------------------------------------------
    // 2. T型加减速处理（速度斜坡生成）
    // ------------------------------------------------------------------------
    // TAccDec.TargetSpeed 是最终期望达到的机械转速（由外部给定，例如电位器或通信指令）
    // T_Shaped_Acc_Dec 函数根据当前速度、目标速度、加速度、减速度等参数，生成平滑的
    // 速度曲线（T型），避免速度突变导致电流冲击或机械振动。
    // 输出 SpeedOut 作为速度环的参考值。
    MC.TAccDec.TargetSpeed = MC.Speed.MechanicalSpeedSet;
    T_Shaped_Acc_Dec(&MC.TAccDec);

    // ------------------------------------------------------------------------
    // 3. 速度环PID控制（按比例分频执行）
    // ------------------------------------------------------------------------
    // 判断是否达到执行速度环的周期（每 SPEED_DIVISION_FACTOR 次执行一次）
    if(MC.Speed.SpeedCalculateCnt >= SPEED_DIVISION_FACTOR)
    {
        MC.Speed.SpeedCalculateCnt = 0;        // 计数器清零，准备下一轮计数

        /* 3.1 获取当前电角度（用于计算速度） */
        // ElectricalPosThis 存储当前电角度（标幺值，范围通常0~1）
//        MC.Speed.ElectricalPosThis = MC.EAngle.ElectricalAnglePU;

        /* 3.2 计算电机转速 */
        // Calculate_Speed 根据当前电角度和上次保存的电角度之差，以及两次采样的时间间隔，
        // 计算出电角速度（单位：rad/s 或 rpm）。内部会进行滤波处理得到 ElectricalSpeedLPF。
//        Calculate_Speed(&MC.Speed);

        /* 3.3 设置速度环PID的参考值和反馈值 */
        MC.SpdPid.Ref = MC.TAccDec.SpeedOut;                  // 目标速度（来自T型加减速输出）
        MC.SpdPid.Fbk = MC.EAngle.EncSpeedElecRPM;            // 反馈速度（PLL输出的电角速度rpm）
        
        /* 3.4 执行速度环PID调节 */
        // PID_Control 根据 Ref 和 Fbk 计算比例、积分项，输出控制量 Out。
        // 该输出即为电流环的 Iq 目标值（转矩电流分量给定）。
        PID_Control(&MC.SpdPid);

        /* 3.5 将速度环输出作为 Iq 电流环的参考值 */
        MC.IqPid.Ref = MC.SpdPid.Out;
    }

    // ============================================================================
    // 以下为电流环部分（每个PWM周期或控制周期都执行，保证电流响应速度）
    // ============================================================================

    // ------------------------------------------------------------------------
    // 4. 读取相电流实际值（反馈值）
    // ------------------------------------------------------------------------
    MC.Foc.Iu = MC.Sample.IuReal;   // U相电流（安培）
    MC.Foc.Iv = MC.Sample.IvReal;   // V相电流（安培）
    // W相电流由基尔霍夫定律隐含计算：Iw = -Iu - Iv

    // ------------------------------------------------------------------------
    // 5. Clark变换：三相静止坐标系 -> 两相静止坐标系（Ialpha, Ibeta）
    // ------------------------------------------------------------------------
    Clark_Transform(&MC.Foc);

    // ------------------------------------------------------------------------
    // 6. Park变换：两相静止坐标系 -> 旋转坐标系（Id, Iq）
    // ------------------------------------------------------------------------
    // 需要当前转子电角度（通常来自编码器、霍尔或观测器），将交流量变换为直流量。
    Park_Transform(&MC.Foc);

//    // ------------------------------------------------------------------------
//    // 7. Id/Iq 低通滤波（一阶滤波，抑制采样噪声）
//    // ------------------------------------------------------------------------
//    // 滤波公式：Y(n) = X(n)*α + Y(n-1)*(1-α)
//    // α 为滤波系数（IdLPFFactor / IqLPFFactor），越接近1响应越快但滤波效果越弱。
//    MC.Foc.IdLPF = MC.Foc.Id * MC.Foc.IdLPFFactor + MC.Foc.IdLPF * (1 - MC.Foc.IdLPFFactor);
//    MC.Foc.IqLPF = MC.Foc.Iq * MC.Foc.IqLPFFactor + MC.Foc.IqLPF * (1 - MC.Foc.IqLPFFactor);

    // ------------------------------------------------------------------------
    // 8. 设置电流环PID的反馈值（使用滤波后的Id/Iq）
    // ------------------------------------------------------------------------
    MC.IqPid.Fbk = MC.Foc.Iq;   // Iq环反馈（转矩电流）
    MC.IdPid.Fbk = MC.Foc.Id;   // Id环反馈（励磁电流）

    // ------------------------------------------------------------------------
    // 9. 执行电流环PID调节（内环，每个周期都执行）
    // ------------------------------------------------------------------------
    // Iq环：参考值来自速度环输出（若速度环未执行则保持上一次的值），输出Uq（q轴电压）
    // Id环：参考值通常为0（最大转矩电流比控制），输出Ud（d轴电压）
    PID_Control(&MC.IqPid);
    PID_Control(&MC.IdPid);

    // ------------------------------------------------------------------------
    // 10. 更新电压指令到FOC结构体
    // ------------------------------------------------------------------------
    MC.Foc.Uq = MC.IqPid.Out;   // q轴电压指令
    MC.Foc.Ud = MC.IdPid.Out;   // d轴电压指令

    // ------------------------------------------------------------------------
    // 11. 反Park变换：旋转坐标系电压 -> 两相静止坐标系电压（Ualpha, Ubeta）
    // ------------------------------------------------------------------------
    // 使用当前电角度将 Ud/Uq 变换回静止坐标系，用于SVPWM调制。
    IPark_Transform(&MC.Foc);

    // ------------------------------------------------------------------------
    // 12. 更新母线电压（直流母线电压采样值）
    // ------------------------------------------------------------------------
    // 母线电压用于SVPWM的占空比计算，实现电压补偿和过调制处理。
    MC.Foc.Ubus = MC.Sample.BusReal;

    // ------------------------------------------------------------------------
    // 13. SVPWM调制：生成三相逆变器的PWM占空比
    // ------------------------------------------------------------------------
    // 空间矢量脉宽调制（Space Vector Pulse Width Modulation），
    // 根据 Ualpha, Ubeta 和母线电压 Ubus，计算三相占空比并写入PWM比较寄存器。
    Calculate_SVPWM(&MC.Foc);
}

/*位置-速度-电流三闭环控制（有感FOC模式*/
void Pos_Speed_Current_Loop(void)
{
    // ============================================================================
    // 第一环：位置环（最外环，按比例分频执行）
    // ============================================================================
    MC.Position.PosCalculateCnt++;
    // 判断是否达到执行位置环的周期（每 POS_DIVISION_FACTOR 次执行一次）
    if(MC.Position.PosCalculateCnt >= POS_DIVISION_FACTOR)
    {
        MC.Position.PosCalculateCnt = 0;            // 计数器清零，准备下一轮计数

        /* 1.1 获取当前电角度，并转换为位置脉冲数 */
        // ElectricalAnglePU 是电角度的标幺值（范围通常0~1，对应0~360°电角度）
        // PUL_MAX 是每转对应的脉冲数（或位置计数最大值），相乘后得到当前位置的脉冲计数值
        MC.Position.ElectricalPosThis = MC.EAngle.ElectricalAnglePU * PUL_MAX;

        /* 1.2 计算总位置（累计位置） */
        // Calculate_Position 根据当前电角度和上次保存的电角度差值，累加得到总位置（圈数+角度），
        // 输出 ElectricalPosSum 为累计电角度位置（单位：脉冲数或电角度*倍数）
        Calculate_Position(&MC.Position);

        /* 1.3 设置位置环PID的反馈值和参考值 */
        MC.PosPid.Fbk = MC.Position.ElectricalPosSum;                        // 反馈实际位置（累计电角度位置）
        MC.PosPid.Ref = MC.Position.MechanicalPosSet * POLEPAIRS;            // 给定目标位置（机械位置 × 极对数 → 电角度位置）

        /* 1.4 计算机械位置原始值（用于外部监控或显示） */
        // 将累计电角度位置除以极对数，得到实际的机械位置（转数或角度）
        MC.Position.MechanicalPosRaw = MC.Position.ElectricalPosSum / POLEPAIRS;

        /* 1.5 执行位置环PID调节 */
        // PID_Control 根据 Ref（目标位置）和 Fbk（实际位置）计算输出 Out，
        // 该输出作为速度环的目标速度（单位：电角速度或转速）
        PID_Control(&MC.PosPid);
    }

    // ============================================================================
    // 第二环：速度环（中环，按比例分频执行）
    // ============================================================================
    MC.Speed.SpeedCalculateCnt++;
    // 判断是否达到执行速度环的周期（每 SPEED_DIVISION_FACTOR 次执行一次）
    if(MC.Speed.SpeedCalculateCnt >= SPEED_DIVISION_FACTOR)
    {
        MC.Speed.SpeedCalculateCnt = 0;            // 计数器清零

        /* 2.1 获取当前电角度（用于速度计算） */
//        MC.Speed.ElectricalPosThis = MC.EAngle.ElectricalAnglePU;    // 电角度标幺值（0~1）

        /* 2.2 计算电机转速 */
//        Calculate_Speed(&MC.Speed);

        /* 2.3 设置速度环PID的参考值和反馈值 */
        MC.SpdPid.Ref = MC.PosPid.Out;                               // 目标速度来自位置环的输出
        MC.SpdPid.Fbk = MC.EAngle.EncSpeedElecRPM;                   // 反馈速度（PLL输出的电角速度rpm）

        if(MC.SpdPid.Fbk > -2000.0f && MC.SpdPid.Fbk < 2000.0f)
        {
            MC.SpdPid.Kp = MC.SpdPid.KpMax;
        }
        else
        {
            MC.SpdPid.Kp = MC.SpdPid.KpMin;
        }
        
        /* 2.4 执行速度环PID调节 */
        // 速度环输出作为电流环的 Iq 目标值（转矩电流给定）
        PID_Control(&MC.SpdPid);

        /* 2.5 将速度环输出作为 Iq 电流环的参考值 */
        MC.IqPid.Ref = MC.SpdPid.Out;
    }

    // ============================================================================
    // 第三环：电流环（内环，每个控制周期都执行）
    // ============================================================================

    // ------------------------------------------------------------------------
    // 3. 读取相电流实际值（反馈值）
    // ------------------------------------------------------------------------
    MC.Foc.Iu = MC.Sample.IuReal;            // U相电流（安培）
    MC.Foc.Iv = MC.Sample.IvReal;            // V相电流（安培）

    // ------------------------------------------------------------------------
    // 4. Clark变换：三相静止坐标系 -> 两相静止坐标系（Ialpha, Ibeta）
    // ------------------------------------------------------------------------
    Clark_Transform(&MC.Foc);

    // ------------------------------------------------------------------------
    // 5. Park变换：两相静止坐标系 -> 旋转坐标系（Id, Iq）
    // ------------------------------------------------------------------------
    // 需要当前转子电角度（从编码器/霍尔/观测器获取），将交流量变为直流量
    Park_Transform(&MC.Foc);

//    // ------------------------------------------------------------------------
//    // 6. Id/Iq 低通滤波（一阶低通滤波，抑制采样噪声）
//    // ------------------------------------------------------------------------
//    // 滤波公式：Y(n) = X(n)*α + Y(n-1)*(1-α)
//    MC.Foc.IdLPF = MC.Foc.Id * MC.Foc.IdLPFFactor + MC.Foc.IdLPF * (1 - MC.Foc.IdLPFFactor);
//    MC.Foc.IqLPF = MC.Foc.Iq * MC.Foc.IqLPFFactor + MC.Foc.IqLPF * (1 - MC.Foc.IqLPFFactor);

    // ------------------------------------------------------------------------
    // 7. 设置电流环PID的反馈值（使用滤波后的Id/Iq）
    // ------------------------------------------------------------------------
    MC.IqPid.Fbk = MC.Foc.Iq;            // Iq环反馈（转矩电流）
    MC.IdPid.Fbk = MC.Foc.Id;            // Id环反馈（励磁电流，通常目标为0）

    // ------------------------------------------------------------------------
    // 8. 执行电流环PID调节（内环，每个周期都执行，保证电流快速响应）
    // ------------------------------------------------------------------------
    // Iq环：参考值来自速度环输出（若速度环未执行则保持上一次的值），输出Uq（q轴电压）
    // Id环：参考值通常为0（最大转矩电流比控制），输出Ud（d轴电压）
    PID_Control(&MC.IqPid);
    PID_Control(&MC.IdPid);

    // ------------------------------------------------------------------------
    // 9. 更新电压指令到FOC结构体
    // ------------------------------------------------------------------------
    MC.Foc.Uq = MC.IqPid.Out;               // q轴电压指令
    MC.Foc.Ud = MC.IdPid.Out;               // d轴电压指令

    // ------------------------------------------------------------------------
    // 10. 反Park变换：旋转坐标系电压 -> 两相静止坐标系电压（Ualpha, Ubeta）
    // ------------------------------------------------------------------------
    // 使用当前电角度将 Ud/Uq 变换回静止坐标系，用于SVPWM调制
    IPark_Transform(&MC.Foc);

    // ------------------------------------------------------------------------
    // 11. 更新母线电压（直流母线电压采样值）
    // ------------------------------------------------------------------------
    // 母线电压用于SVPWM的占空比计算，实现电压补偿和过调制处理。
    MC.Foc.Ubus = MC.Sample.BusReal;

    // ------------------------------------------------------------------------
    // 12. SVPWM调制：生成三相逆变器的PWM占空比
    // ------------------------------------------------------------------------
    // 空间矢量脉宽调制，根据 Ualpha, Ubeta 和母线电压 Ubus 计算三相占空比并写入PWM比较寄存器
    Calculate_SVPWM(&MC.Foc);
}







